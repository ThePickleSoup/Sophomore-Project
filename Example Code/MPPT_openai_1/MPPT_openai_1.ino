/*
  Devin Hernandez
  Sophomore Project Lab
  PV_IES System
  10/10/23

  Code generated by ChatGPT to perform MPPT based on the Perturb and Observe MPPT algorithm.

  Pins used:

  Software Version: 0.1.0
  Changelog:
      > 0.1.0
        -Created Program

*/
// Define analog pins for voltage and current measurements
const int voltagePin = A0;
const int currentPin = A1;

// Define the maximum and minimum voltage values for the solar panel
const float Vmax = 22.0;  // Maximum voltage in Volts
const float Vmin = 0.0;   // Minimum voltage in Volts

// Define the maximum and minimum duty cycle for the DC-DC converter
const int dutyCycleMax = 255;  // Maximum duty cycle
const int dutyCycleMin = 0;    // Minimum duty cycle

// Define variables to store voltage and current readings
float voltage = 0.0;
float current = 0.0;

// Define variables for the perturb and observe algorithm
float previousVoltage = 0.0;
int dutyCycle = 127; // Initial duty cycle

void setup() {
  // Initialize serial communication
  Serial.begin(9600);
}

void loop() {
  // Measure the voltage and current
  voltage = analogRead(voltagePin) * (Vmax - Vmin) / 1023.0 + Vmin;
  current = analogRead(currentPin) * 5.0 / 1023.0;  // Assuming a 5A current sensor
  
  // Calculate the power
  float power = voltage * current;

  // Perturb and Observe Algorithm
  if (voltage > previousVoltage) {
    // Increase the duty cycle
    dutyCycle++;
  } else {
    // Decrease the duty cycle
    dutyCycle--;
  }

  // Limit the duty cycle within the allowed range
  if (dutyCycle > dutyCycleMax) {
    dutyCycle = dutyCycleMax;
  } else if (dutyCycle < dutyCycleMin) {
    dutyCycle = dutyCycleMin;
  }

  // Update the duty cycle of the DC-DC converter
  analogWrite(9, dutyCycle);  // Assuming the DC-DC converter is controlled using PWM on pin 9

  // Print the values for debugging
  Serial.print("Voltage: ");
  Serial.print(voltage);
  Serial.print("V, Current: ");
  Serial.print(current);
  Serial.print("A, Power: ");
  Serial.print(power);
  Serial.print("W, Duty Cycle: ");
  Serial.println(dutyCycle);

  // Store the current voltage for comparison in the next iteration
  previousVoltage = voltage;

  // You can add a delay here to control the loop rate if needed
  delay(1000);  // Delay for 1 second
}